## kern/uboot_img.its
```
/*
 * U-Boot uImage source file with multiple kernels, ramdisks and FDT blobs
 */

/* mkimage -A arm64 -C none -f auto -a 0x80000 -e 0x80000 -n 'kernel' -d build/$(KERN).bin:build/$(KERN).elf build/uImage */

/dts-v1/;

/ {
	description = "RustOS u-boot image and embedded ELF file";
	#address-cells = <1>;

	images {
		kernel-1 {
			description = "RustOS";
			data = /incbin/("build/kernel.bin");
			type = "kernel";
			arch = "arm64";
			os = "linux";
			compression = "none";
			load = <0x80000>;
			entry = <0x80000>;
			hash-1 {
				algo = "sha1";
			};
		};
	};

	configurations {
		default = "config-1";

		config-1 {
			description = "Default RustOS config";
			kernel = "kernel-1";
		};

	};
};
```
